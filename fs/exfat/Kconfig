## fs/exfat/Kconfig
```kconfig
config EXFAT_FS
	tristate "EXFAT file system support (exfat)"
	select NLS
	default y
config EXFAT_DEFAULT_CODEPAGE
        int "Default codepage for exFAT"
        default 437
        depends on EXFAT_FS
        help
          This option should be set to the codepage of your exFAT filesystems.

config EXFAT_DEFAULT_IOCHARSET
        string "Default iocharset for exFAT"
        default "utf8"
        depends on EXFAT_FS
        help
          Set this to the default input/output character set you'd like exFAT to use.
```
